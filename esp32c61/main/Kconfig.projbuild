## esp32c61/main/Kconfig.projbuild
```kconfig
menu "Ultrasound PSRAM raw UDP"
config PSRAM_UDP_MAX_BYTES
    int "Maximum accepted PSRAM buffer length"
    range 4 16777216
    default 1048576
config PSRAM_UDP_TEST_BYTES
    int "PSRAM self-test buffer length"
    range 4 16777216
    default 787456
    help
        Default matches 64 * (8 + 6144) * 2 from the B-mode imaging config.
        Must be no larger than PSRAM_UDP_MAX_BYTES.
config PSRAM_UDP_TIMEOUT_MS
    int "Total upload deadline (milliseconds)"
    range 100 300000
    default 30000
endmenu
menu "SDIO TCP frame performance"
config PSRAM_TCP_DIRECT
    bool "Submit TCP body directly from leased PSRAM to copying socket API"
    default y
    help
        Default combined path: skip the application staging copy after the coalesced
        header/first payload. IDF 6.1 send() still uses NETCONN_COPY; this is
        NOT zero-copy DMA. Retain the frame lease through the PC CRC ACK.
        UDP/selftest retain internal staging. Use isolated builds for comparisons.
config PSRAM_TCP_SEND_BYTES
    int "Send buffer bytes for the upload TCP socket only"
    range 2880 65535
    default LWIP_TCP_SND_BUF_DEFAULT
    help
        Applied to the exclusively owned upload socket before connect().
        Other sockets, including HTTP, retain LWIP_TCP_SND_BUF_DEFAULT.
        Requires the project-local IDF 6.1 lwIP adapter; not a frame buffer.
config PSRAM_TCP_STAGE_BYTES
    int "Internal SRAM TCP staging bytes"
    range 1472 16384
    default 5760
    help
        Shared sender staging allocation, not an additional frame buffer.
        5760 is four default MSS payloads. UDP uses only its existing prefix.
config PSRAM_TCP_HEAP_HEADROOM
    int "Internal SRAM headroom before enqueueing TCP data"
    range 0 32768
    default 16384
    help
        Sender yields if free internal 8-bit heap is below this headroom plus
        twice the attempted write. This is admission backpressure, not a
        guaranteed heap reservation against allocations by other tasks.
endmenu
menu "Zynq UART log and Wi-Fi control"
config ZYNQ_UART_BRIDGE_ENABLE
    bool "Enable Zynq UART0 logs and structured Wi-Fi commands"
    default y
    help
        Receives GPIO10 and sends structured commands on GPIO11, 115200 8N1.
        Monitor input is never forwarded. HTTP commands require no USB or token;
        only use this control interface on a trusted LAN.
        Requires the primary console on USB Serial/JTAG.
endmenu
```
